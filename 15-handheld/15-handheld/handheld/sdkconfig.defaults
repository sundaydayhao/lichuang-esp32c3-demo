## 15-handheld/15-handheld/handheld/sdkconfig.defaults
```kconfig
CONFIG_EXAMPLE_WIFI_SSID="haoge"
CONFIG_EXAMPLE_WIFI_PASSWORD="19901118"
CONFIG_LV_USE_USER_DATA=y
CONFIG_LV_COLOR_16_SWAP=y
CONFIG_LV_COLOR_DEPTH_16=y
```
